## immortalwrt/defconfig
```kconfig
CONFIG_TARGET_x86=y
CONFIG_TARGET_x86_64=y
CONFIG_TARGET_x86_64_DEVICE_generic=y

CONFIG_PACKAGE_luci=y
CONFIG_PACKAGE_luci-ssl=y

# iStore（先写好）
CONFIG_PACKAGE_luci-app-store=y
CONFIG_PACKAGE_istore=y
```
